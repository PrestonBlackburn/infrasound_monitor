## main/Kconfig.projbuild
```kconfig
menu "Example Configuration"

    config EXAMPLE_ENABLE_SSE_HANDLER
        bool "Enable Server-Sent Events (SSE) handler"
        default n
        help
            Enable this option to use Server-Sent Events (SSE) functionality.
            This will allow the server to push real-time updates to the client over an HTTP connection.

endmenu

menu "My WiFi Config"
    config MY_WIFI_SSID
        string "WiFi SSID"
        default "changeme"

    config MY_WIFI_PASSWORD
        string "WiFi Password"
        default "changeme"
endmenu

menu "Infrasound Sensor"
    config INFRASOUND_SENSOR_VERBOSE
        bool "Verbose sensor logging (1 Hz heartbeat)"
        default n
        help
            Emit a once-per-second heartbeat with sample counts, latest
            pressure/dB/temp, ring occupancy, dropped samples, and read
            error counters. Also toggleable at runtime via
            sensor_set_verbose().
endmenu
```

## sdkconfig.defaults
```kconfig
CONFIG_LV_FONT_UNSCII_8=y
CONFIG_ESPTOOLPY_FLASHSIZE_4MB=y
CONFIG_FREERTOS_HZ=1000
CONFIG_PARTITION_TABLE_SINGLE_APP_LARGE=y
```
